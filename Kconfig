## Kconfig
```kconfig
mainmenu "HypeR Kernel Configuration"

menu "Architecture"

config ARCH_AARCH64
    bool "AArch64 architecture"
    default y

config ARCH_RISCV64
    bool "RISC-V 64-bit architecture"
    default n

endmenu

menu "Platform"

config PLATFORM_QEMU_VIRT
    bool "QEMU virt platform"
    default y

endmenu

menu "Kernel"

config RANDOMIZE_BASE
    bool "Randomize the kernel virtual address"
    default y

config MAX_CPUS
    int "Maximum supported CPU count"
    range 1 256
    default 8

config MAX_KERNEL_STACKS
    int "Maximum simultaneously allocated kernel stacks"
    range 64 16384
    default 1024

config KERNEL_STACK_SIZE_KB
    int "Kernel thread stack size in KiB"
    range 16 256
    default 16

config IRQ_STACK_SIZE_KB
    int "Per-CPU IRQ stack size in KiB"
    range 16 128
    default 32

config EMERGENCY_STACK_SIZE_KB
    int "Per-CPU emergency stack size in KiB"
    range 16 128
    default 32

config TIMER_HZ
    int "Kernel timer frequency"
    range 10 10000
    default 100

config TIMER_QUEUE_CAPACITY
    int "Maximum software timers per CPU"
    range 16 4096
    default 256

config CONSOLE_LOGLEVEL
    int "Maximum severity printed to the console"
    range 0 7
    default 6

config LOG_BUF_SHIFT
    int "Kernel log ring size as a power of two"
    range 12 20
    default 16

config LOG_LINE_MAX
    int "Maximum formatted kernel log record length"
    range 128 2048
    default 512

endmenu
```

## configs/qemu_aarch64_defconfig
```kconfig
CONFIG_ARCH_AARCH64=y
CONFIG_PLATFORM_QEMU_VIRT=y
CONFIG_RANDOMIZE_BASE=y
CONFIG_MAX_CPUS=8
CONFIG_TIMER_HZ=100
CONFIG_TIMER_QUEUE_CAPACITY=256
CONFIG_CONSOLE_LOGLEVEL=6
CONFIG_LOG_BUF_SHIFT=16
CONFIG_LOG_LINE_MAX=512
```

## configs/qemu_x86_64_defconfig
```kconfig
CONFIG_ARCH_AARCH64=n
CONFIG_ARCH_RISCV64=n
CONFIG_ARCH_X86_64=y
CONFIG_PLATFORM_QEMU=y
CONFIG_RANDOMIZE_BASE=y
CONFIG_MAX_CPUS=8
CONFIG_MAX_KERNEL_STACKS=1024
CONFIG_KERNEL_STACK_SIZE_KB=16
CONFIG_IRQ_STACK_SIZE_KB=32
CONFIG_EMERGENCY_STACK_SIZE_KB=32
CONFIG_CRASH_CONSOLE=n
CONFIG_TIMER_HZ=100
CONFIG_TIMER_QUEUE_CAPACITY=256
CONFIG_CONSOLE_LOGLEVEL=6
CONFIG_LOG_BUF_SHIFT=16
CONFIG_LOG_LINE_MAX=512
```
